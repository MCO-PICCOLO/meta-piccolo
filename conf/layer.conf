## conf/layer.conf
```bitbake
# We have a conf and classes directory, add to BBPATH
BBPATH .= ":${LAYERDIR}"

# We have recipes-* directories, add to BBFILES
BBFILES += "${LAYERDIR}/recipes-*/*.bb \
            ${LAYERDIR}/recipes-*/*.bbappend \
            ${LAYERDIR}/recipes-*/*/*.bb \
            ${LAYERDIR}/recipes-*/*/*.bbappend"

BBFILE_COLLECTIONS += "piccolo-layer"
BBFILE_PATTERN_piccolo-layer = "^${LAYERDIR}/"
BBFILE_PRIORITY_piccolo-layer = "82"

LAYERDEPENDS_piccolo-layer = "\
    core \
    virtualization-layer \
    openembedded-layer \
"

LAYERSERIES_COMPAT_piccolo-layer = "scarthgap kirkstone"

HOSTTOOLS_NONFATAL:append = " docker skopeo "
```
